## layers/meta-balena-genericx86/conf/layer.conf
```bitbake
BBPATH .= ":${LAYERDIR}"

BBFILES += "${LAYERDIR}/recipes-*/*/*.bb \
            ${LAYERDIR}/recipes-*/*/*.bbappend"

BBFILE_COLLECTIONS += "balena-genericx86"
BBFILE_PATTERN_balena-genericx86 := "^${LAYERDIR}/"
BBFILE_PRIORITY_balena-genericx86 = "1337"

LAYERSERIES_COMPAT_balena-genericx86 = "honister"

FIRMWARE_COMPRESSION ?= "1"
```

## layers/meta-balena-genericx86/conf/machine/genericx86-64-ext.conf
```bitbake
#@TYPE: Machine
##@NAME: genericx86-64-ext
##@DESCRIPTION: Machine configuration for an extra configured genericx86-64 device

MACHINEOVERRIDES = "x86-64:genericx86-64:${MACHINE}"
include conf/machine/genericx86-64.conf

FIRMWARE_COMPRESSION ?= "1"
```

## layers/meta-balena-genericx86/conf/machine/smartcube-kbox-a150.conf
```bitbake
#@TYPE: Machine
##@NAME: smartcube-kbox-a150
##@DESCRIPTION: Machine configuration for smartcube-kbox-a150 based on the extra configured genericx86-64 device

MACHINEOVERRIDES = "genericx86-64-ext:${MACHINE}"
include conf/machine/genericx86-64.conf

PREFERRED_PROVIDER_virtual/kernel = "linux-yocto-rt"
```

## layers/meta-balena-genericx86/conf/machine/smartcube-kbox-a250.conf
```bitbake
#@TYPE: Machine
##@NAME: smartcube-kbox-a250
##@DESCRIPTION: Machine configuration for smartcube-kbox-a250 based on the extra configured genericx86-64 device

MACHINEOVERRIDES = "genericx86-64-ext:${MACHINE}"
include conf/machine/genericx86-64.conf
```

## layers/meta-balena-genericx86/conf/machine/surface-go.conf
```bitbake
#@TYPE: Machine
##@NAME: surface-go
##@DESCRIPTION: Machine configuration for Microsoft Surface Go

MACHINEOVERRIDES = "genericx86-64:${MACHINE}"
include conf/machine/genericx86-64.conf

PREFERRED_VERSION_linux-yocto = "5.8%"
FIRMWARE_COMPRESSION ?= "1"
```

## layers/meta-balena-genericx86/conf/machine/surface-pro-6.conf
```bitbake
#@TYPE: Machine
##@NAME: surface-pro-6
##@DESCRIPTION: Machine configuration for Microsoft Surface Pro 6

MACHINEOVERRIDES = "genericx86-64:${MACHINE}"
include conf/machine/genericx86-64.conf

PREFERRED_VERSION_linux-yocto = "5.0%"

FIRMWARE_COMPRESSION = "0"
```

## layers/meta-balena-genericx86/conf/machine/test-private.conf
```bitbake
#@TYPE: Machine
##@NAME: test-private
##@DESCRIPTION: Machine configuration for an extra configured genericx86-64 device

MACHINEOVERRIDES = "genericx86-64-ext:${MACHINE}"
include conf/machine/genericx86-64-ext.conf

FIRMWARE_COMPRESSION ?= "1"

MACHINE_FEATURES += " efi raid"
```
